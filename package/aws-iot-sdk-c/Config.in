## package/aws-iot-sdk-c/Config.in
```kconfig
config BR2_PACKAGE_AWS_IOT_SDK_C
	bool "aws-iot-sdk-c"
	select BR2_PACKAGE_OPENSSL
	help
	  Amazon AWS IoT Hub device SDK for C is used
	  to connect devices running C code to Azure IoT Hub.

	  https://github.com/aws/aws-iot-device-sdk-embedded-C
```
